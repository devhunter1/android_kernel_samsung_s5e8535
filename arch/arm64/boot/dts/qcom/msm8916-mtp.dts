/dts-v1/;

#include "msm8916-pm8916.dtsi"

/ {
	interrupt-parent = <0x01>;
	#address-cells = <0x02>;
	#size-cells = <0x02>;
	model = "Qualcomm Technologies, Inc. MSM 8916 MTP";
	compatible = "qcom,msm8916-mtp", "qcom,msm8916-mtp/1", "qcom,msm8916";

	aliases {
		serial0 = &blsp1_uart2;
		usid0 = &pm8916_0;
	};

	chosen {
		stdout-path = "serial0";
	};
};

&blsp1_uart2 {
	status = "okay";
};
